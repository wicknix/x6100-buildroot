## package/libsndfile-with-lame-and-mpg123/Config.in
```kconfig
config BR2_PACKAGE_LIBSNDFILE_WITH_LAME_AND_MPG123
	bool "libsndfile-with-lame-and-mpg123"
	help
	  Libsndfile is a C library for reading and writing files
	  containing sampled sound (such as MS Windows WAV and the
	  Apple/SGI AIFF format) through one standard library interface.

	  http://www.mega-nerd.com/libsndfile/
```
